## br2-external/Config.in
```kconfig
source "$BR2_EXTERNAL_MCU_BRIDGE_PATH/package/mcb-bridge/Config.in"
source "$BR2_EXTERNAL_MCU_BRIDGE_PATH/package/mcbd/Config.in"
```

## br2-external/package/mcb-bridge/Config.in
```kconfig
config BR2_PACKAGE_MCB_BRIDGE
	bool "mcb-bridge"
	depends on BR2_LINUX_KERNEL
	help
	  serdev driver for the mcu-bridge ESP32 link (driver/ in the
	  mcu-bridge repository).

comment "mcb-bridge needs a Linux kernel to be built"
	depends on !BR2_LINUX_KERNEL
```

## br2-external/package/mcbd/Config.in
```kconfig
config BR2_PACKAGE_MCBD
	bool "mcbd"
	depends on BR2_PACKAGE_MCB_BRIDGE
	help
	  User-space daemon for the mcb_bridge driver: logs samples to a
	  CSV file and link events to syslog (daemon/ in the mcu-bridge
	  repository). Started at boot by /etc/init.d/S50mcbd.
```

## dts/bindings/mcubridge,esp32.yaml
```yaml
# SPDX-License-Identifier: (GPL-2.0-only OR BSD-2-Clause)
%YAML 1.2
---
$id: http://devicetree.org/schemas/mcubridge,esp32.yaml#
$schema: http://devicetree.org/meta-schemas/core.yaml#

title: mcu-bridge ESP32 link over UART

maintainers:
  - Shashank <smshashanksm@gmail.com>

description: |
  An ESP32 running the mcu-bridge Zephyr firmware, attached to a UART. It
  streams CRC-32 framed samples and answers commands (ping, set rate).
  The node must be a child of the UART it is wired to; the serdev core then
  hands that UART to the driver instead of creating a tty device.

allOf:
  - $ref: /schemas/serial/serial-peripheral-props.yaml#

properties:
  compatible:
    const: mcubridge,esp32

  current-speed:
    description: Line rate configured in the ESP32 firmware.
    default: 115200

required:
  - compatible

unevaluatedProperties: false

examples:
  - |
    serial {
        mcu {
            compatible = "mcubridge,esp32";
            current-speed = <115200>;
        };
    };
```
